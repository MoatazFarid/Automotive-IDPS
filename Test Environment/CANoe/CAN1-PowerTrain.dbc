VERSION ""

NS_ :

BS_:

BU_: Console_1 Engine

BO_ 18 Speed_MSG: 8 Engine
 SG_ Speed : 0|8@1+ (1,0) [0|255] "kmph"  Console_1

BO_ 17 TempPetrol_MSG: 8 Engine
 SG_ TempLevel : 8|8@1+ (2,-50) [-50|150] "degC"  Console_1
 SG_ PetrolLevel : 0|8@1+ (1,0) [0|255] "l"  Console_1

EV_ env_Speed: 0 [0|0] "" 0 1 DUMMY_NODE_VECTOR0  Engine;

EV_ env_Petrol: 0 [0|0] "" 0 2 DUMMY_NODE_VECTOR0  Engine;

EV_ env_Temp: 0 [0|0] "" 0 3 DUMMY_NODE_VECTOR0  Engine;

BA_DEF_  "BusType" STRING ;
BA_DEF_DEF_  "BusType" "CAN";
